## boards/shields/macropad3x3/Kconfig.defconfig
```kconfig
if SHIELD_MACROPAD3X3

# Name must be less than 16 characters long!
config ZMK_KEYBOARD_NAME
    default "Macropad3x3"

endif

# ---------------------
# Kconfig for shield "macropad3x3" with board "nice_nano_v2"
# ---------------------
if BOARD_NICE_NANO_V2 && SHIELD_MACROPAD3X3

config SPI
    default y

endif
```
